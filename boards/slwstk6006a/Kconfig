## boards/slwstk6006a/Kconfig
```kconfig
# Copyright (c) 2020 HAW Hamburg
#
# This file is subject to the terms and conditions of the GNU Lesser
# General Public License v2.1. See the file LICENSE in the top level
# directory for more details.

config BOARD
    default "slwstk6006a" if BOARD_SLWSTK6006A

config BOARD_SLWSTK6006A
    bool
    default y
    select CPU_MODEL_EFR32MG21A020F1024IM32
    select HAS_PERIPH_TIMER
    select HAS_PERIPH_UART
```
